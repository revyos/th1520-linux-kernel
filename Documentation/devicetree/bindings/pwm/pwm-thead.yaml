## Documentation/devicetree/bindings/pwm/pwm-thead.yaml
```yaml
# SPDX-License-Identifier: (GPL-2.0-only OR BSD-2-Clause)
%YAML 1.2
---
$id: http://devicetree.org/schemas/pwm/pwm-thead.yaml#
$schema: http://devicetree.org/meta-schemas/core.yaml#

title: T-HEAD PWM

maintainers:
  - Jisheng Zhang <jszhang@kernel.org>

allOf:
  - $ref: pwm.yaml#

properties:
  compatible:
    enum:
      - thead,th1520-pwm

  reg:
    maxItems: 1

  clocks:
    maxItems: 1

  "#pwm-cells":
    const: 2

required:
  - compatible
  - reg
  - clocks

additionalProperties: false

examples:
  - |

    pwm@ec01c000 {
        compatible = "thead,th1520-pwm";
        reg = <0xec01c000 0x1000>;
        clocks = <&clk 1>;
        #pwm-cells = <2>;
    };
```

## Documentation/devicetree/bindings/riscv/thead,cpu-reset.yaml
```yaml
# SPDX-License-Identifier: (GPL-2.0-only or BSD-2-Clause)
%YAML 1.2
---
$id: http://devicetree.org/schemas/riscv/thead,cpu-reset.yaml#
$schema: http://devicetree.org/meta-schemas/core.yaml#

title: T-HEAD cpu reset controller

maintainers:
  - Jisheng Zhang <jszhang@kernel.org>

description: |
  The secondary CPUs in T-HEAD SMP capable platforms need some special
  handling. The first one is to write the warm reset entry to entry
  register. The second one is write a SoC specific control value to
  a SoC specific control reg. The last one is to clone some CSRs for
  secondary CPUs to ensure these CSRs' values are the same as the
  main boot CPU.

properties:
  $nodename:
    pattern: "^cpurst"

  compatible:
    oneOf:
      - description: CPU reset on T-HEAD TH1520 SoC
        items:
          - const: thead,reset-th1520

  entry-reg:
    $ref: /schemas/types.yaml#/definitions/uint64
    description: |
      The entry reg address.

  entry-cnt:
    $ref: /schemas/types.yaml#/definitions/uint32
    description: |
      The entry reg count.

  control-reg:
    $ref: /schemas/types.yaml#/definitions/uint32
    description: |
      The control reg address.

  control-val:
    $ref: /schemas/types.yaml#/definitions/uint32
    description: |
      The value to be set into the control reg.

  csr-copy:
    $ref: /schemas/types.yaml#/definitions/uint32-array
    description: |
      The CSR registers to be cloned during CPU warm reset.

required:
  - compatible

additionalProperties: false

examples:
  - |
    cpurst: cpurst@ffff019050 {
      compatible = "thead,reset-th1520";
      entry-reg = <0xff 0xff019050>;
      entry-cnt = <4>;
      control-reg = <0xff 0xff015004>;
      control-val = <0x1c>;
      csr-copy = <0x7f3 0x7c0 0x7c1 0x7c2 0x7c3 0x7c5 0x7cc>;
    };
```
